## yocto/meta-imx6ull-mini/conf/layer.conf
```bitbake
# We have a conf and classes directory, add to BBPATH
BBPATH .= ":${LAYERDIR}"

BBFILES += "${LAYERDIR}/recipes-*/*/*.bb ${LAYERDIR}/recipes-*/*/*.bbappend"

BBFILE_COLLECTIONS += "imx6ull-mini"
BBFILE_PATTERN_imx6ull-mini = "^${LAYERDIR}/"
BBFILE_PRIORITY_imx6ull-mini = "8"

LAYERDEPENDS_imx6ull-mini = "core"
LAYERSERIES_COMPAT_imx6ull-mini = "scarthgap"
```

## yocto/meta-imx6ull-mini/conf/machine/imx6ull-mini.conf
```bitbake
#@TYPE: Machine
#@NAME: imx6ull-mini
#@DESCRIPTION: 正点原子 i.MX6ULL Mini（Cortex-A7 / 512MB DDR / SD 卡启动 / 4.3 寸屏）

require conf/machine/include/arm/armv7a/tune-cortexa7.inc

DEFAULTTUNE = "cortexa7thf-neon"

KERNEL_IMAGETYPE = "zImage"
PREFERRED_PROVIDER_virtual/kernel = "linux-imx6ull-mini"
PREFERRED_PROVIDER_u-boot = "u-boot-imx6ull-mini"
PREFERRED_PROVIDER_virtual/bootloader = "u-boot-imx6ull-mini"

UBOOT_MACHINE = "mx6ull_alientek_mini_defconfig"
UBOOT_ENTRYPOINT = "0x80008000"
UBOOT_LOADADDRESS = "0x80008000"

# 板级串口：U-Boot 与内核都用 ttymxc0
SERIAL_CONSOLES = "115200;ttymxc0"

MACHINE_FEATURES = "usbhost usbgadget alsa touchscreen screen"
MACHINE_EXTRA_RRECOMMENDS = ""

IMAGE_FSTYPES ?= "tar.bz2 ext4"
```
